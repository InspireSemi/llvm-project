## CMakeLists.txt
```
# SPDX-License-Identifier: Apache-2.0

cmake_minimum_required(VERSION 3.20.0)

# Enable C11 for better static assertions while maintaining C99 compatibility
set(CMAKE_C_STANDARD 11)
set(CMAKE_C_STANDARD_REQUIRED ON)
set(CMAKE_C_EXTENSIONS ON)  # Keep ON for __attribute__((packed))

find_package(Zephyr REQUIRED HINTS $ENV{ZEPHYR_BASE})
project(fs_shell)

# Main application sources
FILE(GLOB app_sources src/*.c)

# Library sources
FILE(GLOB ivshmem_sources lib/ivshmem/src/*.c)
FILE(GLOB messaging_sources lib/messaging/src/*.c)
FILE(GLOB device_sources lib/device/src/*.c)
FILE(GLOB memory_sources lib/memory/src/*.c)
# Test sources
# FILE(GLOB common_test_sources tests/common/src/*.c)
# FILE(GLOB unit_test_sources tests/unit/src/*.c)
# FILE(GLOB integration_test_sources tests/integration/src/*.c)
# FILE(GLOB demo_test_sources tests/demo/src/*.c)

# Add main sources to the app target
target_sources(app PRIVATE
    ${app_sources}
    ${ivshmem_sources}
    ${messaging_sources}
    ${device_sources}
    ${memory_sources}
    ${common_test_sources}
    ${unit_test_sources}
)

# Include directories for main application
target_include_directories(app PRIVATE
    .                        # Project root for simplified includes
    include
    lib/ivshmem/include
    lib/messaging/include
    lib/common/include
    lib/device/include
    lib/memory/include
    tests/common/include
    tests/unit/include
    ${PROJECT_BINARY_DIR}/include/generated  # Generated include files
    ${ZEPHYR_BASE}/lib/posix/options
)

# Add llext subdirectory
# add_subdirectory(tests/llext/saxpy_llext)
# add_subdirectory(tests/llext/hello_world_mod)

# Ensure the llext is built before the main app so the generated include is available
# add_dependencies(app hello_world_ext)
# add_dependencies(app saxpy_llext_ext)
```

## prj.conf
```kconfig
CONFIG_LOG=y
CONFIG_LOG_DEFAULT_LEVEL=3
CONFIG_LOG_MODE_IMMEDIATE=y
CONFIG_LOG_THREAD_ID_PREFIX=y
CONFIG_LOG_BUFFER_SIZE=4096

CONFIG_SHELL=n
CONFIG_SHELL_CMD_BUFF_SIZE=8192
CONFIG_SHELL_LOG_LEVEL_INF=y
CONFIG_SHELL_STACK_SIZE=4096

CONFIG_LLEXT=y
CONFIG_LLEXT_LOG_LEVEL_DBG=y
CONFIG_LLEXT_IMPORT_ALL_GLOBALS=y
CONFIG_LLEXT_HEAP_SIZE=1024
CONFIG_LLEXT_SHELL=n
CONFIG_LLEXT_TYPE_ELF_SHAREDLIB=y
CONFIG_LLEXT_STORAGE_WRITABLE=y

# Enable kernel heap
CONFIG_HEAP_MEM_POOL_SIZE=65536

# Enable memory debugging
CONFIG_KERNEL_MEM_POOL=y
CONFIG_SYS_HEAP_RUNTIME_STATS=y

# Threading configuration
CONFIG_NUM_PREEMPT_PRIORITIES=56
CONFIG_MAIN_THREAD_PRIORITY=7
CONFIG_TIMESLICING=y
CONFIG_TIMESLICE_SIZE=0
CONFIG_TIMESLICE_PRIORITY=0

# Dynamic thread stack allocation
CONFIG_DYNAMIC_THREAD=y
CONFIG_THREAD_STACK_INFO=y

# Increase system workqueue stack
CONFIG_SYSTEM_WORKQUEUE_STACK_SIZE=2048
```

## src/main.c
```c
/**
 * @file main.c
 * @brief Thunderbird Device Runtime main application
 */

#define LOG_LEVEL CONFIG_LOG_DEFAULT_LEVEL
#include <zephyr/logging/log.h>
#include <zephyr/sys/printk.h>
#include <zephyr/devicetree.h>
#include <zephyr/sys/util.h>
#include <zephyr/kernel.h>
#include <string.h>

#include <zephyr/llext/llext.h>
#include <zephyr/llext/buf_loader.h>
#include <zephyr/llext/symbol.h>


// Core includes
#include "ivshmem_dt.h"
#include "mailbox.h"
#include "mailbox_region.h" 
#include "mailbox_operations.h"
#include "ivshmem_heap.h"
#include "message_router.h"
#include "message_slot.h"
#include "error_codes.h"
#include "device_memory.h"
#include "message_router.h"
#include "batch_controller.h"

// Test includes
#include "unit_test_framework.h"

LOG_MODULE_REGISTER(app);

// Export kernel functions for LLEXT modules
// EXPORT_SYMBOL(k_malloc);
// EXPORT_SYMBOL(k_free);

// /**
//  * @brief Run all test suites
//  */
// static void run_all_tests(void)
// {
//     LOG_INF("\n=== Running Test Suites ===");
    
//     // Run unit tests
//     LOG_INF("\n--- Unit Tests ---");
//     int unit_test_result = run_all_unit_tests();
//     if (unit_test_result != 0) {
//         LOG_WRN("Unit tests completed with failures");
//     } else {
//         LOG_INF("All unit tests passed!");
//     }
    
//     // Run integration tests
//     LOG_INF("\n--- Integration Tests ---");
//     // TODO: Add integration test runner when available
    
//     LOG_INF("=== Test Suites Complete ===\n");
// }

/**
 * @brief Send an error response for unhandled messages
 * @param original_msg The original message that couldn't be handled
 */
static void send_error_response(const message_slot_t* original_msg)
{
    // For now, just log the error. In a full implementation,
    // we would send an error response back to the host
    LOG_ERR("Unhandled message type: %d", original_msg->msg_id);
}

/**
 * @brief Main message processing loop
 * @details Continuously monitors the H2D mailbox for incoming messages
 *          and processes them using the message handler
 */
static void message_processing_loop(void)
{
    k_timeout_t timeout = K_MSEC(100);

    while (true) {
        message_slot_t request_msg;
        uint32_t slot_index_received = 0;
        
        if (mailbox_receive(&request_msg, timeout, &slot_index_received)) {
            LOG_DBG("Received message ID %u from slot %u", request_msg.msg_id, slot_index_received);
            
            // Just route - no response handling needed explicitly
            message_router_handle(&request_msg, slot_index_received);
        }
        
        k_msleep(10000);
    }
}


/**
 * @brief Initialize system components
 */
static bool init_system(void)
{
    // Initialize device memory first
    int ret = device_memory_init();
    if (ret != 0) {
        LOG_ERR("Device memory initialization failed: %d", ret);
        return false;
    }
    
    // Now test shared memory allocation
    void *ptr = device_shared_malloc(8);
    if (!ptr) {
        LOG_ERR("Shared memory allocation failed");
        return false;
    }
    device_shared_free(ptr);

    // Initialize mailbox region
    mailbox_region_init(); // void return, FIXME
    if (ret != 0) {
        LOG_ERR("Mailbox region initialization failed: %d", ret);
        return false;
    }
    
    // Verify initialization
    const mailbox_region_t* region = mailbox_region_get();
    if (!region) {
        LOG_ERR("Mailbox region initialization failed");
        return false;
    }
    
    size_t heap_size = device_shared_total_size();
    LOG_INF("System initialized - Heap: %zu bytes", heap_size);
    
    return true;
}

int main(void)
{
    LOG_INF("Thunderbird Device Runtime v0.2");
    
    // Initialize system
    if (!init_system()) {
        LOG_ERR("System initialization failed");
        return -1;
    }
    
    // Run all tests
    // run_all_tests();

    // Start message processing
    LOG_INF("Entering message processing mode");

    // clear out the mailbox
    mailbox_region_reset();
    // clear the batch controller state so noise from unit testing improperly reset doesn't affect the main loop
    batch_controller_reset_state();

    message_processing_loop();
    
    return 0;
}
```
